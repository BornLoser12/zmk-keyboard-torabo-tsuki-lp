/*
 * Copyright (c) 2025 sekigon-gonnoc
 *
 * SPDX-License-Identifier: MIT
 */

/ {
	pro_micro: connector {
		compatible = "arduino-pro-micro";
		#gpio-cells = <2>;
		gpio-map-mask = <0xffffffff 0xffffffc0>;
		gpio-map-pass-thru = <0 0x3f>;
		gpio-map
			= <0 0 &gpio0 11 0>
			, <1 0 &gpio0 8 0>
			, <2 0 &gpio0 18 0>
			, <3 0 &gpio0 16 0>
			, <4 0 &gpio0 19 0>
			, <5 0 &gpio0 20 0>
			, <6 0 &gpio0 22 0>
			, <7 0 &gpio0 23 0>
			, <8 0 &gpio1 0 0>
			, <9 0 &gpio1 3 0>
			, <10 0 &gpio0 9 0>
			, <16 0 &gpio0 10 0>
			, <14 0 &gpio1 15 0>
			, <15 0 &gpio1 14 0>
			, <18 0 &gpio0 3 0>
			, <19 0 &gpio0 30 0>
			, <20 0 &gpio0 0 0>
			, <21 0 &gpio0 5 0>
			;
	};

	pro_micro_a: connector_a {
		compatible = "arduino-pro-micro";
		#gpio-cells = <2>;
		gpio-map-mask = <0xffffffff 0xffffffc0>;
		gpio-map-pass-thru = <0 0x3f>;
		gpio-map
			= <0 0 &gpio0 3 0>
			, <1 0 &gpio0 30 0>
			, <3 0 &gpio0 5 0>
			;
	};
};
