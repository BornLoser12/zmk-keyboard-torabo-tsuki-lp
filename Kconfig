## Kconfig
```kconfig
config TORABO_BLE_RECONNECT_DIAGNOSTICS
    bool "Torabo Tsuki BLE reconnect diagnostics"
    default n
    depends on ZMK_BLE && ZMK_SPLIT_ROLE_CENTRAL

config TORABO_STUDIO_USB_INDEPENDENT
    bool "Use USB Studio independently of the HID output"
    default y
    depends on ZMK_STUDIO_TRANSPORT_UART && ZMK_USB && ZMK_SPLIT_ROLE_CENTRAL
    depends on SHIELD_TORABO_TSUKI_LP_LEFT || SHIELD_TORABO_TSUKI_LP_RIGHT
    help
      Prefer the Studio USB transport whenever the USB host is configured,
      without changing the selected keyboard output or Bluetooth profile.
      Fall back to the normal Studio transport selection when USB disconnects.
```

## boards/arm/bmp_boost/Kconfig.bmp_boost
```kconfig
# SPDX-License-Identifier: MIT

config BOARD_BMP_BOOST
    select SOC_NRF52840_QIAA
    select ZMK_BOARD_COMPAT
```

## config/west.yml
```yaml
manifest:
  remotes:
    - name: zmkfirmware
      url-base: https://github.com/zmkfirmware
    - name: sekigon-gonnoc
      url-base: https://github.com/sekigon-gonnoc
    - name: cormoran
      url-base: https://github.com/cormoran
  projects:
    - name: zmk
      remote: cormoran
      revision: e5c9b6915b56801193e359dd9bad4a167ce0d1b8
      import: app/west.yml
    - name: zmk-feature-status-led
      remote: sekigon-gonnoc
      revision: main
    - name: zmk-driver-paw3222
      remote: sekigon-gonnoc
      revision: torabo-tsuki
    - name: zmk-driver-iqs7211e
      remote: sekigon-gonnoc
    - name: zmk-feature-cdc-acm-bootloader-trigger
      remote: sekigon-gonnoc
      revision: v0.2
    - name: zmk-feature-non-lipo-battery-management
      remote: sekigon-gonnoc
      revision: main
    - name: zmk-driver-kscan-4-direction-switch
      remote: sekigon-gonnoc
    - name: zmk-module-ble-management
      remote: cormoran
      revision: 57738cc4fc6ba80e82a7ac57741a0339cb186cd4
    - name: zmk-module-settings-rpc
      remote: cormoran
      revision: 78f86df9e6c5edaf57bef3ccbd7f360cfdf49291
    - name: zmk-feature-custom-settings
      remote: cormoran
      revision: c6a7fef3a3be3d3ace5de9a4b0628c6418cd1f3f
    - name: zmk-module-runtime-input-processor
      remote: cormoran
      revision: 43618985f8c9d5457cc333b7ca0733f2d361911e
    - name: zmk-feature-module-physical-layout
      remote: cormoran
      revision: 4f18de45dc27820725d267916b4cdacc0e0b6cf9
    - name: zmk-feature-runtime-combo
      remote: cormoran
      revision: d9490e7b5d41c516221d131241009e81740efcee
    - name: zmk-feature-runtime-macro
      remote: cormoran
      revision: 38530962eb7061b60efcb98e84585cfb1f0cb6de
    - name: zmk-feature-fast-keymap
      remote: cormoran
      revision: 8dac76de0ba38588ba39ca498910e24f8332bc6b
  self:
    path: config
```
